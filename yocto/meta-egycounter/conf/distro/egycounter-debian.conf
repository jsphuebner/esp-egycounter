## yocto/meta-egycounter/conf/distro/egycounter-debian.conf
```bitbake
require conf/distro/poky.conf

DISTRO = "egycounter-debian"
DISTRO_NAME = "egycounter Debian-style distro"

PACKAGE_CLASSES = "package_deb"
EXTRA_IMAGE_FEATURES += "package-management"

# headless image
DISTRO_FEATURES:remove = "x11 wayland opengl"

VIRTUAL-RUNTIME_init_manager = "systemd"
DISTRO_FEATURES:append = " systemd"
DISTRO_FEATURES:remove = "sysvinit"

# Prefer custom kernel recipe based on ti-linux-kernel-dev
PREFERRED_PROVIDER_virtual/kernel = "linux-ti-rcn"
```
